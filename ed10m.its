## ed10m.its
```
/dts-v1/;
/ {
        description = "ED10M";
        #address-cells = <1>;

        images {
                kernel {
                        description = "Kernel";
                        data = /incbin/("image_output/Image");
                        type = "kernel";
                        arch = "arm64";
                        os = "linux";
                        compression = "none";
                        load = <0x40480000>;
                        entry = <0x40480000>;
                        hash {
                                algo = "sha1";
                        };
                };
                fdt {
                        description = "DTB";
                        data = /incbin/("image_output/imx8mp-verdin-wifi-dev.dtb");
                        type = "flat_dt";
                        arch = "arm64";
                        compression = "none";
                        load = <0x43000000>;
                        entry = <0x43000000>;
                        hash {
                                algo = "sha1";
                        };
                };
                fdt_evk {
                        description = "DTB";
                        data = /incbin/("from_evk/imx8mp-verdin-wifi-dev.dtb");
                        type = "flat_dt";
                        arch = "arm64";
                        compression = "none";
                        load = <0x43000000>;
                        entry = <0x43000000>;
                        hash {
                                algo = "sha1";
                        };
                };
                fdt_hdmi {
                        description = "DTB";
                        data = /incbin/("from_evk/verdin-imx8mp_lt8912_overlay.dtbo");
                        //data = /incbin/("from_evk/verdin-imx8mp_native-hdmi_overlay.dtbo");
                        type = "flat_dt";
                        arch = "arm64";
                        compression = "none";
                        load = <0x43100000>;
                        entry = <0x43100000>;
                        hash {
                                algo = "sha1";
                        };
                };                                
                initrd {
                        description = "Initrd";
                        data = /incbin/("initramfs");
                        type = "ramdisk";
                        arch = "arm64";
                        os = "linux";
                        compression = "none";
                        hash {
                                algo = "sha1";
                        };
                };
        };

        configurations {
                default = "standard";
                standard {
                        description = "default";
                        kernel = "kernel";
                        //fdt = "fdt";
                        fdt = "fdt_evk", "fdt_hdmi";
                        ramdisk = "initrd";
                        hash {
                                algo = "sha1";
                        };
                };
        };
};
```
